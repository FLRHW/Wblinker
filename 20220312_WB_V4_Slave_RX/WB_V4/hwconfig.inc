
// -----------------------------------------------------------------------------------------------
//		DEFINES COMMON HW SETTINGS FOR MASTER AND SLAVE MODES

CONFIG:
// STARTUP DELAY
	LDI		TMP,200						// WAITS TO ENSURE POWER SUPPLY IS STABLE
	RCALL	DELAY_MS

// DATA INIT
	CLR		ERRCNT						// RESETS ERROR COUNTER
	LDI		DATA_OUT,DEFAULT			//LOADS DEFAULT DATA OUT VALUE

// STACK CONFIGURATION
	LDI		TMP,LOW(RAMEND)
	OUT		SPL,TMP
	LDI		TMP,HIGH(RAMEND)
	OUT		SPH,TMP	

// OPERATION MODE
	CLR		FL							// CLEARS FLAGS (ALSO SETS BOARD STD CONFIGURATION AS IN SLAVE MODE)
	SBIC	PIND,HW_ID					// CHECKS OPERATION MODE AND STORES FLAG ACCORDINGLY
	SBR		FL,(1<<MASTER)					// HW_ID = HIGH -> FLAG HIGH, HW_ID = LOW, LEAVE FLAG IN LOW

// CONFIGURES DISPLAY
	RCALL	DISP_INI
	RCALL	CLEAR_SC
//	RCALL	ANIMATION					// RUNS STARTUP ANIMATION
	RCALL	LOAD_DEF_SCREEN				// LOADS DEFAULT SCREEN INTO DISPLAY

// ADC INIT
	LDI		TMP,ADC_CFG	
	STS		ADMUX,TMP
	LDI		TMP,(1<<ADEN|1<<ADSC|1<<ADIE|1<<ADPS2|1<<ADPS1|1<<ADPS0)	// 0B11100111 - ADC ENABLED, CONVERSION STARTED, INTERRUPT ENABLED, 128:1 PRESCALER
	STS		ADCSRA,TMP
	LDI		TMP,0B00001111				// DISABLES DIGITAL INPUT BUFFERS - NOT APPLICABLE TO CH 6 AND 7
	STS		DIDR0,TMP
	
// RUNS DEDICATED MODE CONFIGURATION
	BST		FL,MASTER					// STORES OPERATION MODE IN T BIT
	BRTC	HW_SLAVE_MODE				// CHECKS IF T IS CLEAR (SLAVE MODE)
HW_MASTER_MODE:							// T IS SET, BOARD OPERATES IN MASTER MODE
	RCALL	CFG_M_MODE
	RJMP	END_CFG
HW_SLAVE_MODE:							// T IS CLEAR, BOARD OPERATES IN SLAVE MODE
	RCALL	CFG_S_MODE
	RJMP	END_CFG

END_CFG:
	SEI									// ENABLES INTERRUPTS
	RJMP	MAIN_LOOP

// -----------------------------------------------------------------------------------------------
//		HW_ID IS HIGH, CONFIGURES BOARD TO OPERATE IN MASTER MODE

CFG_M_MODE:
// USART INIT
	LDI		TMP,BAUDH					// CONFIGURES BAUD RATE WITH DEFAULT VALUE
	STS		UBRR0H,TMP
	LDI		TMP,BAUDL
	STS		UBRR0L,TMP
	LDI		TMP,(1<<TXEN0)				// ENABLES TRANSMITTER
	STS		UCSR0B,TMP
	LDI		TMP,(1<<UPM01|1<<UCSZ01|1<<UCSZ00) // ASYNCHRONOUS MODE, EVEN PARITY, 1 STOP BIT, 8 BIT DATA
	STS		UCSR0C,TMP
	
//PORT CONFIGURATION
	LDI		TMP,DDRD_INI_M				
	OUT		DDRD,TMP
	LDI		TMP,DDRC_INI_M
	OUT		DDRC,TMP
	LDI		TMP,DDRB_INI_M
	OUT		DDRB,TMP

// TIMER 0 CONFIGURATION (INTERRUPT GEN)
	LDI		TMP,0B00000010				// NON PWM MODE, CTC
	OUT		TCCR0A,TMP
	LDI		TMP,0B00000101				// PRESCALER 1024:1
	OUT		TCCR0B,TMP
	LDI		TMP,TX_HF_DEL				// COMPARE TO TX_HF_DEL FOR INTERRUPT
	OUT		OCR0A,TMP
	LDI		TMP,(1<<OCIE0A)				// ENABLES COMPARE MATCH A INTERRUPT
	STS		TIMSK0,TMP

// TIMER 2 CONFIGURATION (TH_ADJ)
// TBD
 
// TIMER 1 CONFIGURATION (MODE 14 FAST PWM - H BRIDGE PWM A AND B)
	LDI		TMP,(1<<COM1A1|1<<COM1B1|1<<COM1B0|1<<WGM11) // 0B10110010 - MODE 14, CLEAR OC1x ON COMPARE MATCH, CH A NON INVERTING, CH B INVERTING			
	STS		TCCR1A,TMP
	LDI		TMP,(1<<WGM13|1<<WGM12|1<<CS10)				// 0B00011001 - MODE 14, PRESCALER 1:1 
	STS		TCCR1B,TMP
	LDI		TMP,DEF_ICR_H				// LOADS DEFAULT TOP VALUE IN ICR1 (DEFAULT FREQUENCY)
	LDI		TMP2,DEF_ICR_L
	STS		ICR1H,TMP					// (HIGH BYTE MUST BE WRITEN FIRST; READING MUST BE FIRST ON LOW BYTE)
	STS		ICR1L,TMP2
	LSR		TMP							// DIVIDES VALUE BY 2 FOR DUTY = 50 %
	ROR		TMP2
	STS		OCR1AH,TMP					// LOADS TOP/2 (DUTY) IN OCR1A AND OCR1B
	STS		OCR1AL,TMP2
	STS		OCR1BH,TMP			
	STS		OCR1BL,TMP2	
	
// UPDATES DISPLAY
	RCALL	FREQ_CALC					// CALCULATES CARRIER FREQUENCY BASED ON CURRENT ICR1(TOP) VALUE AND STORES IN SRAM (FREQ_H:FREQ_M:FREQ_L)
	MOV		TMP3,FREQ_H					// FREQ_PWM = FREQHZ/(1+TOP)
	MOV		TMP4,FREQ_M
	MOV		TMP5,FREQ_L
	RCALL	SHOWS_FREQ					// PRINTS FREQUENCY
	RET

// -----------------------------------------------------------------------------------------------
//		HW_ID IS LOW, CONFIGURES BOARD TO OPERATE IN SLAVE MODE

CFG_S_MODE:
//PORT CONFIGURATION
	LDI		TMP,DDRD_INI_S
	OUT		DDRD,TMP
	LDI		TMP,DDRC_INI_S
	OUT		DDRC,TMP
	LDI		TMP,DDRB_INI_S
	OUT		DDRB,TMP

// TIMER 0 (TX RESPONSE TIMER)
	LDI		TMP,0B00000010				// NON PWM MODE, CTC
	OUT		TCCR0A,TMP
	CLR		TMP							// STARTS WITHOUT CLOCK SOURCE (TIMER STOPPED)
	OUT		TCCR0B,TMP
	LDI		TMP,R_T_DEL					// COMPARES TO R_T_DEL FOR INTERRUPT (RX TO TX DELAY ON SLAVE MODE)
	OUT		OCR0A,TMP
	LDI		TMP,0						// STARTS WITH DISABLED INTERRUPTS
	STS		TIMSK0,TMP

// TIMER 1 CONFIGURATION (BRAKE OUT)
// TIMER 2 NOT USED

// USART CONFIG FOR SLAVE MODE
	LDI		TMP,BAUDH					// CONFIGURES BAUD RATE WITH DEFAULT VALUE
	STS		UBRR0H,TMP
	LDI		TMP,BAUDL
	STS		UBRR0L,TMP
	LDI		TMP,(1<<RXCIE0|1<<RXEN0|1<<TXEN0)	// ENABLES TX, RX AND RX INTERRUPT
	STS		UCSR0B,TMP
	LDI		TMP,(1<<UPM01|1<<UCSZ01|1<<UCSZ00) // ASYNCHRONOUS MODE, EVEN PARITY, 1 STOP BIT, 8 BIT DATA
	STS		UCSR0C,TMP

	ORI		FL,(1<<RX_WIN)				// RX DATA WILL NOT BE IGNORED

	RET



