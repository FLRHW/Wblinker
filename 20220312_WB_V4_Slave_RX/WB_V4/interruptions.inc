/*	**********************************************************************************************
	 
	FELIPE LOPASSO RODRIGUES
	********************************************************************************************** */


// -----------------------------------------------------------------------------------------------
//		USART DATA HAS BEEN RECEIVED

USART_RX:
	CONTEXT_BACKUP
	LDS		TMP,UDR0					// LOADS RECEIVED DATA IN TMP TO CLEAR INTERRUPT STATE
	SBRS	FL,RX_WIN					// CHECKS IF RX WINDOW IS OPENED
	RJMP	INT_RX_END					// NO (RX_WIN=0), ENDS INTERRUPT IGNORING RECEIVED DATA
WINDOW_OPENED:
	LDS		TMP2,UCSR0A					// SAVES STATUS REGISTER IN TMP2
	ANDI	TMP2,(1<<FE0|1<<UPE0)		// CHECKS FRAME ERROR AND PARITY ERROR
	BRNE	INT_RX_END					// ERRORS DETECTED, IGNORES DATA AND FINISHES INTERRUPT
NO_ERROR:								// NO ERRORS DETECTED, TRANSMISSION HAS BEEN CORRECTLY RECEIVED
	MOV		DATA_IN,TMP					// STORES DATA RECEIVED (PREVIOUSLY LOADED ON TMP REGISTER)
//	SBR		FL,NEW_DATA					// SETS NEW DATA RECEIVED FLAG
	SBRS	FL,MASTER					// CHECKS IF BOARD OPERATES IN MASTER MOVE, IF SO, CONFIGURES UART AND FLAG FOR MASTER MODE
	RJMP	RX_S_CFG					// IF NOT, CONFIGURES USART AND FLAG FOR SLAVE MODE

RX_M_CFG:
	ANDI	FL,255-(1<<RX_WIN)			// CLOSES RX WINDOW SO THAT NEXT DATA WILL BE IGNORED
	RJMP	INT_RX_END

RX_S_CFG:
	CLR		TMP
	STS		TCNT0,TMP					// CLEARS TIMER0 COUNTER
	LDI		TMP,(1<<OCIE0A)				// ENABLES COMPARE MATCH A INTERRUPT
	STS		TIMSK0,TMP
	LDI		TMP,0B00000101				// STARTS TIMER (PRESCALER 1024:1)
	OUT		TCCR0B,TMP
//	RJMP	INT_RX_END

INT_RX_END:								// FINALIZES INTERRUPTION ROUTINE
	CONTEXT_RESTORE
	RETI

// -----------------------------------------------------------------------------------------------
//		USART TX COMPLETE

USART_TX:
	CONTEXT_BACKUP
	SBRS	FL,MASTER					// CHECKS IF BOARD OPERATES IN MASTER MOVE
	ORI		FL,1<<RX_WIN				// IF NOT, SETS TO ACCEPT RX DATA ON NEXT RECEIVE CYCLE
TX_CFG:									// EITHER WAY, REWRITES USART CONFIG AND FLAG (NOT REQUIRED FOR SLAVE, BUT NOT AFFECTING IT EITHER) 
	LDI		TMP,(1<<RXCIE0|1<<RXEN0|1<<TXEN0)	// ENABLES RECEPTION INTERRUPT AND RECEIVER WHILE KEEPING
	STS		UCSR0B,TMP					// TRANSMITTER ENABLED AND TX INTERRUPT DISABLED
	ORI		FL,1<<TX_CP					// INDICATES THAT A TRANSMISSION HAS BEEN COMPLETED SINCE LAST TRANSMIT TENTATIVE
USART_TX_END:
	CONTEXT_RESTORE
	RETI


// -----------------------------------------------------------------------------------------------
//		TMR0 MATCH

TMR0_COMPA:
	CONTEXT_BACKUP
	SBRS	FL,MASTER					// CHECKS IF BOARD OPERATES IN MASTER MOVE, IF SO, CONTINUES WITH MASTER ROUTINES
	RJMP	TMR0_SLAVE					// IF NOT, CONTINUES WITH SLAVE ROUTINES

	SBRC	FL,T0_TX					// CHECKS IF TIMER WAS SET TO INTERRUPT FOR NEXT TRANSMISSION
	RJMP	TMR_TX						// YES (T0_TX=1), GOES TO TRANSMISSION ROUTINE
NOT_TMR_TX:
	SBRC	FL,T0_RXEN					// CHECKS IF TIMER WAS SET TO "OPEN" RX WINDOW
	RJMP	TMR_RXEN					// YES (TO_RXEN=1), GOES TO RX WINDOW OPENING ROUTINE
MID_TMR:								// NO, GOES TO MID TIMER ROUTINE
	LDI		TMP,TX_HF_DEL				// UPDATES TIMER TO INTERRUPT. DELAY CORRESPONDS TO HALF THE TIME BETWEEN RX ENABLE WINDOW AND TRANSMIT START
	OUT		OCR0A,TMP
	ANDI	FL,255-(1<<T0_RXEN)			// CLOSES RX WINDOW
	ORI		FL,1<<T0_TX					// UPDATES TIMER STATE FLAG. NEXT TIMER INTERRUP: NOT(T0_RXEN), T0_TX
	RJMP	TMR0_INT_END

TMR_RXEN:
	LDI		TMP,TX_HF_DEL				// UPDATES TIMER TO INTERRUPT. DELAY CORRESPONDS TO TIME BETWEEN RX ENABLE WINDOW AND MID TMR INTERRUPT
	OUT		OCR0A,TMP
	ANDI	FL,255-(1<<T0_RXEN|1<<T0_TX)// UPDATES TIMER STATE FLAGS. NEXT TIMER INTERRUPT: NOT(T0_RXEN), NOT(T0_TX)
	SBRC	FL,TX_CP					// CHECKS WHETHER A TX COMPLETE INTERRUPT HAS BEEN EXECUTED AFTER LAST TRANSMIT TENTATIVE
	ORI		FL,1<<RX_WIN				// YES, THEN "OPENS" RX WINDOW
	RJMP	TMR0_INT_END				// NO, KEEPS RX WINDOW "CLOSED" AND FINISHES INTERRUPT ROUTINE

TMR_TX:
	LDI		TMP,RXEN_DEL				// UPDATES TIMER TO INTERRUPT. DELAY CORRESPONDS TO TIME BETWEEN TX START AND RX ENABLE WINDOW
	OUT		OCR0A,TMP
	ORI		FL,1<<T0_RXEN				// UPDATES TIMER STATE FLAGS. NEXT TIMER INTERRUPT: T0_RXEN, NOT(T0_TX)
	ANDI	FL,255-(1<<T0_TX)
	ANDI	FL,255-(1<<TX_CP)			// UPDATES TRANSMISSION STATE FLAGS (CLEARS TRANSMISSION COMPLETE)
		LDI		TMP,(1<<TXEN0|1<<TXCIE0)	// ENABLES TRANSMITTER, ENABLES TRANSMISSION COMPLETE INTERRUPT, DISABLES RECEIVER AND RECEIVE INTERRUPT
		STS		UCSR0B,TMP
M_TRANSMIT:
	LDS		TMP,UCSR0A
	SBRS	TMP,UDRE0					// CHECKS IF NEW TRANSMISSION CAN BE EXECUTED (IF DATA REGISTER IS EMPTY, UDRE0=1)
	RJMP	M_TRANSMIT					// IF NOT, CHECKS AGAIN UNTIL PERIPHERAL IS READY
	STS		UDR0,DATA_OUT				// STORES NEW DATA IN TRASMIT BUFFER
	RJMP	TMR0_INT_END

TMR0_SLAVE:
		LDI		TMP,(1<<TXEN0|1<<TXCIE0|1<<RXEN0|1<<RXCIE0)	// ENABLES TRANSMITTER WHILE KEEPING RECEIVER AND RX INTERRUPT ENABLED
		STS		UCSR0B,TMP
	CLR		TMP							// STOPS TIMER
	OUT		TCCR0B,TMP
	LDI		TMP,0						// DISABLES TIMER INTERRUPT
	STS		TIMSK0,TMP
	ANDI	FL,255-(1<<RX_WIN)			// SETS FLAG TO IGNORE RECEIVE DATA
S_TRANSMIT:
	LDS		TMP,UCSR0A
	SBRS	TMP,UDRE0					// CHECKS IF NEW TRANSMISSION CAN BE EXECUTED (IF DATA REGISTER IS EMPTY, UDRE0=1)
	RJMP	S_TRANSMIT					// IF NOT, CHECKS AGAIN UNTIL PERIPHERAL IS READY
	STS		UDR0,DATA_OUT				// STORES NEW DATA IN TRASMIT BUFFER
//	RJMP	TMR0_INT_END

TMR0_INT_END:
	CONTEXT_RESTORE
	RETI


// -----------------------------------------------------------------------------------------------
//		AD CONVERSION COMPLETE

ADC_COMPLETE:
//RETI
	CONTEXT_BACKUP
	EXT_CONTEXT_BACKUP

	LDS		TMP,ADMUX
	ANDI	TMP,0B00001111				// LEAVES ONLY BITS RELEVANT TO ADC MUX
	CPI		TMP,0						// CHECKS WHAT CHANNEL HAS BEEN READ AND TREATS ACCORDINGLY
	BREQ	STORES_ADC0
	CPI		TMP,1
	BREQ	STORES_ADC1
	CPI		TMP,2
	BREQ	STORES_ADC2
	CPI		TMP,3
	BREQ	STORES_ADC3
	CPI		TMP,6
	BREQ	STORES_ADC6
	CPI		TMP,7
	BREQ	STORES_ADC7
	RJMP	END_ADC

STORES_ADC0:
	SBRS	FL,ADC_REF_C				// CHECKS IF THE REFERENCE HAS JUST BEEN CHANGED JUST BEFORE LAST CONVERSION
	RJMP	ADC0_REF_STABLE				// NO, SO STORES DATA
ADC0_REF_CHANGED:						// YES, IGNORES DATA READ ON LAST CONVERSION
	ANDI	FL,255-(1<<ADC_REF_C)		// INDICATES THE REFERENCE WILL BE STABLE FOR NEXT CYCLE
	RJMP	END_ADC
ADC0_REF_STABLE:
	LDS		TMP,ADCH
	STS		AIN_RIGHT,TMP
	LDI		TMP,(ADC_CFG|1)
	STS		ADMUX,TMP					// SETS NEXT CHANNEL AS CH 1, KEEPS AVCC AS REFERENCE
	RJMP	END_ADC

STORES_ADC1:
	LDS		TMP,ADCH
	STS		AIN_LEFT,TMP
	LDI		TMP,(ADC_CFG|2)
	STS		ADMUX,TMP					// SETS NEXT CHANNEL AS CH 2, KEEPS AVCC AS REFERENCE
	RJMP	END_ADC

STORES_ADC2:
	LDS		TMP,ADCH
	STS		AIN_L_DET,TMP
	LDI		TMP,(ADC_CFG|6)
	STS		ADMUX,TMP					// SETS NEXT CHANNEL AS CH 6, KEEPS AVCC AS REFERENCE
	RJMP	END_ADC

STORES_ADC6:
	LDS		TMP,ADCH
	STS		AIN_SW,TMP
	RCALL	CONV_SW
	LDI		TMP,(ADC_CFG|7)
	STS		ADMUX,TMP					// SETS NEXT CHANNEL AS CH 0, KEEPS AVCC AS REFERENCE
	RJMP	END_ADC

STORES_ADC7:
	LDS		TMP,ADCH
	STS		AIN_BRAKE,TMP
	LDI		TMP,(ADC_CFG|1<<REFS1|3)
	STS		ADMUX,TMP					// SETS NEXT CHANNEL AS CH 3, CHANGES REFERENCE TO 1.1 V
	ORI		FL,(1<<ADC_REF_C)			// INDICATES REFERENCE HAS BEEN CHANGED
	RJMP	END_ADC

STORES_ADC3:
	DEC		ADC_C_COUNTER				// DECREASES ADC WAIT CYCLES COUNTER
	BRNE	END_ADC						// IF COUNTER HAS NOT REACHED 0, IGNORES DATA FROM THIS CYCLE
ADC3_COUNTER_END:						// COUNTER HAS REACHED 0
	LDI		TMP,ADC_WAIT_CYCLES
	MOV		ADC_C_COUNTER,TMP			// REFRESHES ADC WAIT CYCLES COUNTER WITH TOP COUNTING VALUE

	LDS		TMP,ADCH
	STS		AIN_12V,TMP
	RCALL	CONV_UBAT
	LDI		TMP,(ADC_CFG)
	STS		ADMUX,TMP					// SETS NEXT CHANNEL AS CH 7, CHANGES REFERENCE TO AVCC
	ORI		FL,(1<<ADC_REF_C)			// INDICATES REFERENCE HAS BEEN CHANGED
	RJMP	END_ADC

END_ADC:
	LDS		TMP,ADCSRA
	ORI		TMP,(1<<ADSC)				// SETS START CONVERSION BIT
	STS		ADCSRA,TMP
	EXT_CONTEXT_RESTORE
	CONTEXT_RESTORE
	RETI

// -----------------------------------------------------------------------------------------------
//		CONVERTS SWITCHES ADC VALUE STORED IN TMP TO A DECIMAL TO BE DISPLAYED AND STORES IT IN SW_DATA

CONV_SW:
	MOV		TMP2,UBAT
	CPI		TMP2,05						// IN CASE VBAT IS TOO LOW ADC SW VALUES CANNOT BE TRUSTED
	BRLO	SW_C_0

	CPI		TMP,149
	BRLO	SW_C_7
	CPI		TMP,158
	BRLO	SW_C_6
	CPI		TMP,170
	BRLO	SW_C_5
	CPI		TMP,185
	BRLO	SW_C_4
	CPI		TMP,203
	BRLO	SW_C_3
	CPI		TMP,221
	BRLO	SW_C_2
	CPI		TMP,244
	BRLO	SW_C_1
SW_C_0:
	LDI		SW_DATA,0
	RET
SW_C_1:
	LDI		SW_DATA,100
	RET
SW_C_2:
	LDI		SW_DATA,10
	RET
SW_C_3:
	LDI		SW_DATA,110
	RET
SW_C_4:
	LDI		SW_DATA,1
	RET
SW_C_5:
	LDI		SW_DATA,101
	RET
SW_C_6:
	LDI		SW_DATA,11
	RET
SW_C_7:
	LDI		SW_DATA,111
	RET


// -----------------------------------------------------------------------------------------------
//		CONVERTS ADC VALUE STORED IN TMP TO BATERY VOLTAGE X 10 (E.G.: 137 = 13.7 V) AND STORES IT IN UBAT

CONV_UBAT:
	LDI		TMP2,232
	MUL		TMP,TMP2					// MULTIPLIES BY 232 (10 x FACTOR TO OBTAIN ONE DECIMAL DIGIT)
	
	MOV		DDRT0,R0					// LOADS MULTIPLICATION RESULT INTO DDRTx
	MOV		DDRT1,R1
	CLR		TMP
	MOV		DDRT2,TMP
	MOV		DDRT3,TMP
	MOV		DVRS1,TMP					// LOADS 255 INTO DVRSx
	LDI		TMP,255
	MOV		DVRS0,TMP
	RCALL	udiv32_16					// DIVIDES BY 255
	MOV		UBAT,DDRT0
	RET
