// -----------------------------------------------------------------------------------------------
//		ANIMATION
ANIMATION:
IMAGELD:
	LDI		ZH,HIGH(2*IMAGE)			// POINTS Z TO IMAGE DATA
	LDI		ZL,LOW(2*IMAGE)
	RCALL	SHOW_IMAGE
	LDI		TMP,80
	RCALL	DELAY_DS
	RCALL	CLEAR_SC
WIRELESS:
	POS_DEF	2,15
	P_STR	W_STR,10					// PRINTS "WIRELESS" WITH A 10 mS DELAY BETWEEN CHARS
	LDI		TMP,100
	RCALL	DELAY_MS
	P_STR	BL_STR,0					// PRINTS "WIRELESS" WITHOUT DELAY BETWEEN CHARS
INV_PREP:
	LDI		TMP2,7
	LDI		TMP,4
INV_ANIM:
	RCALL	DELAY_DS
	RCALL	OLED_B						// BLACK PIXELS IN WHITE BACKGROUND
	RCALL	DELAY_DS
	RCALL	OLED_W						// WHITE PIXELS IN BLACK BACKGROUND
	MOV		TMP3,TMP					//	TMP = TMP+TMP/2
	LSR		TMP3
	ADD		TMP,TMP3
	DEC		TMP2
	BRNE	INV_ANIM
TRANS_REC:								// PRINT REVISION
	LDI		TMP,50
	RCALL	DELAY_DS
	LDI		POSV,5
	RCALL	SET_POS

	SBRS	FL,MASTER					// CHECKS IF DEVICE IS IN MASTER MODE
	RJMP	SET_ID_STR_S
//	RJMP	SET_ID_STR_M				// LOADS MASTER STRING (LOW = SLAVE, HIGH = MASTER)
SET_ID_STR_M:
	P_STR	V4_M_STR,0					// PRINTS MASTER STRING WITHOUT DELAY BETWEEN CHARS
	RJMP	DEL_ANIM
SET_ID_STR_S:
	P_STR	V4_M_STR,0					// PRINTS SLAVE STRING WITHOUT DELAY BETWEEN CHARS
//	RJMP	DEL_ANIM
DEL_ANIM:
	LDI		TMP,1
	RCALL	DELAY_S
	RCALL	CLEAR_SC
	LDI		TMP,50
	RCALL	DELAY_DS
	RET

// -----------------------------------------------------------------------------------------------
//		SHOWS SCREEN

LOAD_DEF_SCREEN:
	POS_DEF	1,0
	SBRS	FL,MASTER					// CHECKS IF DEVICE IS IN MASTER MODE
	RJMP	LD_S_M
//	RJMP	LD_M_M						// LOADS MASTER STRING (LOW = SLAVE, HIGH = MASTER)
LD_M_M:
	P_STR	MM_STR,0
	POS_DEF	1,110						// IF DEVICE IS IN MASTER MODE, PRINTS "Hz"
	P_CHAR	'H'
	P_CHAR	'z'
	RJMP	DEF_SC_CONTINUE
LD_S_M:
	P_STR	SM_STR,0
//	RJMP	DEF_SC_CONTINUE
DEF_SC_CONTINUE:
	POS_DEF	3,0							// PRINTS DO_STR ON LINE 3, COLUMN 0, WITH 0 DELAY BETWEEN CHARS
	P_STR	DO_STR,0
	POS_DEF	3,64						// PRINTS DO_STR ON LINE 3, COLUMN 64, WITH 0 DELAY BETWEEN CHARS
	P_STR	DI_STR,0
	POS_DEF	4,0							// PRINTS SW_STR ON LINE 4, COLUMN 0, WITH 0 DELAY BETWEEN CHARS
	P_STR	SW_STR,0
	RET

// -----------------------------------------------------------------------------------------------
//
/*SHOWS_LEDS:
	MOV		TMP2,TMP
	ANDI	TMP,1<<FREIO_D
	BREQ	FREIO_BAIXO
	SBI		PORTD,LED2					// ***** PLACEHOLDER PARA LED CORRESPONDENTE AO FREIO
	RJMP	TESTA_ESQ
FREIO_BAIXO:
	CBI		PORTD,LED2
TESTA_ESQ:
	MOV		TMP,TMP2
	ANDI	TMP,1<<ESQ_D
	BREQ	ESQ_APAGADA
ESQ_ACESA:
	SBI		PORTD,LED1					// ***** PLACEHOLDER PARA LED CORRESPONDENTE А SETA ESQUERDA
	RJMP	TESTA_DIR
ESQ_APAGADA:
	CBI		PORTD,LED1
TESTA_DIR:
	MOV		TMP,TMP2
	ANDI	TMP,1<<DIR_D
	BREQ	DIR_APAGADA
DIR_ACESA:
	SBI		PORTB,LED3					// ***** PLACEHOLDER PARA LED CORRESPONDENTE А SETA DIREITA
	RJMP	FIM_LEDS
DIR_APAGADA:
	CBI		PORTB,LED3
FIM_LEDS:
	RET
	*/
// -----------------------------------------------------------------------------------------------
//		FREQUENCIA A EXIBIR DEVE ESTAR SALVA EM TMP3:5 
SHOWS_FREQ:	
	POS_DEF	1,64
	LDI		TMP,0
	RCALL	IMP_SEQ
	RET

// -----------------------------------------------------------------------------------------------
//
SHOWS_DATA:
	// PRINTS DATA (ALREADY/TO BE) TRANSMITTED
	CLR		TMP4	
	MOV		TMP5,DATA_OUT				// TMP5 = DATA_OUT
	POS_DEF	3,36
	CLR		TMP
	RCALL	IMP_SEQ3					// PRINTS DATA

	// PRINTS LAST DATA RECEIVED
	CLR		TMP4	
	MOV		TMP5,DATA_IN				// TMP5 = DATA_IN
	POS_DEF	3,90
	CLR		TMP
	RCALL	IMP_SEQ3					// PRINTS DATA

	// PRINTS SWITCHES STATUS
	MOV		TMP5,SW_DATA
	POS_DEF	4,36
	CLR		TMP							// DOES NOT PRINT DECIMAL SEPARATOR
	CLR		TMP4						// CLEARS REGISTER AS VALUE IS NOT HIGHER THAN 255
	RCALL	IMP_SEQ3					// PRINTS DATA	

	// CONVERTS AND PRINTS BATTERY VOLTAGE
	POS_DEF	7,60
	P_CHAR	'U'							// PRINTS "UB:"
	P_CHAR	'B'
	P_CHAR	':'
	CLR		TMP4						// LOADS RESULTS IN TMP4:5
	MOV		TMP5,UBAT
	P_CHAR	' '
	LDI		TMP,1
	RCALL	IMP_SEQ3					// PRINTS VOLTAGE (3 DIGITS, 1 TO THE RIGHT OF DECIMAL SEPARATOR)
	P_CHAR	' '
	P_CHAR	'V'

	BST		FL,MASTER					// STORES OPERATION MODE IN T BIT
	BRTC	SHOWS_S_DATA				// CHECKS IF T IS CLEAR (SLAVE MODE), IF SO, SHOWS DATA RELATED TO SLAVE MODE

SHOWS_M_DATA:							// OTHERWISE (MASTER MODE), SHOWS DATA RELATED TO MASTER MODE
	// PRINTS LEFT RAW DATA
	POS_DEF	6,0
	P_CHAR	'L'							// PRINTS "L:"
	P_CHAR	':'
	CLR		TMP4						// CLEARS REGISTER AS VALUE IS NOT HIGHER THAN 255
	LDS		TMP5,AIN_LEFT				// TMP5 = LEFT RAW DATA
	P_CHAR	' '
	CLR		TMP
	RCALL	IMP_SEQ3					// PRINTS DATA

	// PRINTS BRAKE RAW DATA
	POS_DEF	6,45
	P_CHAR	'B'							// PRINTS "B:"
	P_CHAR	':'
	CLR		TMP4						// CLEARS REGISTER AS VALUE IS NOT HIGHER THAN 255
	LDS		TMP5,AIN_BRAKE				// TMP5 = BRAKE RAW DATA
	P_CHAR	' '
	CLR		TMP
	RCALL	IMP_SEQ3					// PRINTS DATA

	// PRINTS RIGHT RAW DATA
	POS_DEF	6,90
	P_CHAR	'R'							// PRINTS "R:"
	P_CHAR	':'
	CLR		TMP4						// CLEARS REGISTER AS VALUE IS NOT HIGHER THAN 255
	LDS		TMP5,AIN_RIGHT				// TMP5 = RIGHT RAW DATA
	P_CHAR	' '
	CLR		TMP
	RCALL	IMP_SEQ3					// PRINTS DATA

	// PRINTS LEVEL DETECTION RAW DATA
	POS_DEF	7,0
	P_CHAR	'L'							// PRINTS "LD:"
	P_CHAR	'D'
	P_CHAR	':'
	CLR		TMP4						// CLEARS REGISTER AS VALUE IS NOT HIGHER THAN 255
	LDS		TMP5,AIN_L_DET				// TMP5 = LEVEL DETECTION RAW DATA
	P_CHAR	' '
	CLR		TMP
	RCALL	IMP_SEQ3					// PRINTS DATA
	RJMP	END_SHOWS_DATA

SHOWS_S_DATA:
	
//	RJMP	END_SHOWS_DATA

END_SHOWS_DATA:
	RET



// -----------------------------------------------------------------------------------------------
//	TMP4:5 DEVEM SER PREVIAMENTE CARREGADOS COM VALOR A CONVERTER

IMP_SEQ3:
	CLC
	CPI		TMP,3
	BRNE	GO_1K
	P_CHAR	'.'						// PRINTS DECIMAL POINT
GO_1K:
	LDI		PAYLD,ZERO				// LIMPA CONTADOR DE SUBTRACOES (ACUMULADOR PARA DIGITO A SER IMPRESSO)
	RJMP	_1K						// CALCULA APENAS OS TRES ULTIMOS DIGITOS
	
// -----------------------------------------------------------------------------------------------
//	ROTINA PARA CONVERTER NUMERO DE 3 BYTES E IMPRIMIR
//	TMP3:5 DEVEM SER PREVIAMENTE CARREGADOS COM VALOR A CONVERTER
//	TMP2 CONTAINS THE POSITION TO PRINT DECIMAL SEPARATOR (7=TO THE LEFT OF ALL 7 DIGITS, 0=NOT TO BE PRINTED)

IMP_SEQ:
	LDI		PAYLD,ZERO
	CPI		TMP,7
	BRNE	_10M
	P_CHAR	'.'						// PRINTS DECIMAL POINT
	LDI		PAYLD,ZERO
	CLC
_10M:
	INC		PAYLD					// INCREMENTA CONTADOR DE SUBTRACOES
	SUBI	TMP5,LOW(1000000)		// SUBTRAI 1 000 000 DO NUMERO A SER MOSTRADO
	SBCI	TMP4,BYTE2(1000000)
	SBCI	TMP3,BYTE3(1000000)
	BRSH	_10M					// SE NUMERO' >= 0 CONTINUA SUBTRAINDO
PREP_1M:
	DEC		PAYLD					// NUMERO' < 0, DECREMENTA CONTADOR DE SUBTRACOES
	LDI		TMP6,LOW(1000000)		// SOMA 1 000 000 NOVAMENTE PARA RETORNAR PARA VALOR NAO NEGATIVO
	ADD		TMP5,TMP6
	LDI		TMP6,BYTE2(1000000)
	ADC		TMP4,TMP6
	LDI		TMP6,BYTE3(1000000)
	ADC		TMP3,TMP6
	RCALL	CHAR6X8						// IMPRIME DIGITO
	LDI		PAYLD,ZERO
	CPI		TMP,6
	BRNE	_1M
	P_CHAR	'.'						// PRINTS DECIMAL POINT
	LDI		PAYLD,ZERO
_1M:
	INC		PAYLD					// INCREMENTA CONTADOR DE SUBTRACOES
	SUBI	TMP5,LOW(100000)
	SBCI	TMP4,BYTE2(100000)
	SBCI	TMP3,BYTE3(100000)		// FAZ NUMERO - 100 000
	BRSH	_1M						// SE NUMERO >= 0 CONTINUA SUBTRAINDO
PREP_100K:
	DEC		PAYLD					// NUMERO < 0, DECREMENTA CONTADOR DE SUBTRACOES
	LDI		TMP6,LOW(100000)		// SOMA 100 000 NOVAMENTE PARA RETORNAR PARA VALOR NAO NEGATIVO
	ADD		TMP5,TMP6
	LDI		TMP6,BYTE2(100000)
	ADC		TMP4,TMP6
	LDI		TMP6,BYTE3(100000)
	ADC		TMP3,TMP6
	RCALL	CHAR6X8						// IMPRIME DIGITO
	LDI		PAYLD,ZERO
	CPI		TMP,5
	BRNE	_100K
	P_CHAR	'.'						// PRINTS DECIMAL POINT
	LDI		PAYLD,ZERO
_100K:
	INC		PAYLD					// INCREMENTA CONTADOR DE SUBTRACOES
	SUBI	TMP5,LOW(10000)
	SBCI	TMP4,BYTE2(10000)		// FAZ NUMERO - 10 000
	SBCI	TMP3,0
	BRSH	_100K					// SE NUMERO >= 0 CONTINUA SUBTRAINDO
PREP_10K:
	DEC		PAYLD					// NUMERO < 0, DECREMENTA CONTADOR DE SUBTRACOES
	LDI		TMP6,LOW(10000)			// SOMA 10 000 NOVAMENTE PARA RETORNAR PARA VALOR NAO NEGATIVO
	ADD		TMP5,TMP6
	LDI		TMP6,BYTE2(10000)
	ADC		TMP4,TMP6
	LDI		TMP6,0
	ADC		TMP3,TMP3
	RCALL	CHAR6X8						// IMPRIME DIGITO
	LDI		PAYLD,ZERO
	CPI		TMP,4
	BRNE	_10K
	P_CHAR	'.'						// PRINTS DECIMAL POINT
	LDI		PAYLD,ZERO
_10K:
	INC		PAYLD					// INCREMENTA CONTADOR DE SUBTRACOES
	SUBI	TMP5,LOW(1000)
	SBCI	TMP4,BYTE2(1000)		// FAZ NUMERO - 1 000
	BRSH	_10K					// SE NUMERO >= 0 CONTINUA SUBTRAINDO
PREP_1K:
	DEC		PAYLD					// NUMERO < 0, DECREMENTA CONTADOR DE SUBTRACOES
	LDI		TMP6,LOW(1000)			// SOMA 1 000 NOVAMENTE PARA RETORNAR PARA VALOR NAO NEGATIVO
	ADD		TMP5,TMP6
	LDI		TMP6,BYTE2(1000)
	ADC		TMP4,TMP6
	RCALL	CHAR6X8						// IMPRIME DIGITO
	LDI		PAYLD,ZERO
	CPI		TMP,3
	BRNE	_1K
	P_CHAR	'.'						// PRINTS DECIMAL POINT
	LDI		PAYLD,ZERO
_1K:
	INC		PAYLD					// INCREMENTA CONTADOR DE SUBTRACOES
	SUBI	TMP5,100				// FAZ NUMERO - 100
	SBCI	TMP4,0					// SUBTRAI APENAS O CARRY
	BRSH	_1K						// SE NUMERO >= 0 CONTINUA SUBTRAINDO
PREP_100:
	DEC		PAYLD					// NUMERO < 0, DECREMENTA CONTADOR DE SUBTRACOES
	LDI		TMP6,100				// SOMA 100 NOVAMENTE PARA RETORNAR PARA VALOR NAO NEGATIVO
	ADD		TMP5,TMP6
	LDI		TMP6,0
	ADC		TMP4,TMP6
	RCALL	CHAR6X8						// IMPRIME DIGITO
	LDI		PAYLD,ZERO
	CPI		TMP,2
	BRNE	_100
	P_CHAR	'.'						// PRINTS DECIMAL POINT
	LDI		PAYLD,ZERO
_100:
	INC		PAYLD					// INCREMENTA CONTADOR DE SUBTRACOES
	SUBI	TMP5,10					// FAZ NUMERO - 10
	BRSH	_100					// SE NUMERO >= 0 CONTINUA SUBTRAINDO
PREP_10:
	DEC		PAYLD					// NUMERO < 0, DECREMENTA CONTADOR DE SUBTRACOES
	LDI		TMP6,10					// SOMA 10 NOVAMENTE PARA RETORNAR PARA VALOR NAO NEGATIVO
	ADD		TMP5,TMP6
	RCALL	CHAR6X8						// IMPRIME DIGITO
	LDI		PAYLD,ZERO
	CPI		TMP,1
	BRNE	_10
	P_CHAR	'.'						// PRINTS DECIMAL POINT
	LDI		PAYLD,ZERO
_10:
	INC		PAYLD					// INCREMENTA CONTADOR DE SUBTRACOES
	SUBI	TMP5,1					// FAZ NUMERO - 1
	BRSH	_10						// SE NUMERO >= 0 CONTINUA SUBTRAINDO
PREP_FIM:
	DEC		PAYLD					// NUMERO < 0, DECREMENTA CONTADOR DE SUBTRACOES
	LDI		TMP6,1					// SOMA 1 NOVAMENTE PARA RETORNAR PARA VALOR NAO NEGATIVO
	ADD		TMP5,TMP6
	RCALL	CHAR6X8						// IMPRIME DIGITO
	RET

