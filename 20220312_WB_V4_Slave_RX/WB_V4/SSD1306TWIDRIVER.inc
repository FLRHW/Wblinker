// ---------------------------------------------------------------------------------------------------
/*		DRIVER FOR 128 X 64 OLED DISPLAY (SSD1306)

FOLLOWING REGISTERS MUST BE DEFINED, BUT WILL NOT BE CHANGED BY THE ROUTINES:
	TMP		->		GENERAL PURPOSE REGISTER, INPUT TO SOME ROUTINES
	TMP2	->		GENERAL PURPOSE REGISTER (USED IN DELAY ROUTINES)
	TMP3	->		GENERAL PURPOSE REGISTER (USED IN DELAY ROUTINES)
	POSH	->		HORIZONTAL POSITION (COLUMN) TO START PRINTING DATA, 0 TO 127
	POSV	->		VERTICAL POSITION (PAGE) TO START PRINTING DATA, 0 TO 8
	PAYLD	->		DATA TO BE PRINTED

FOLLOWING REGISTERS WILL BE USED, BUT NOT CHANGED BY THE ROUTINES:
	ZL		->		Z POINTER, LOW BYTE
	ZH		->		Z POINTER, HIGH BYTE

FOLLOWING LIBRARIES ARE NEEDED:
	DELAYS.INC

AUTHOR: FELIPE LOPASSO RODRIGUES
NOVEMBER 2020

*/

// ---------------------------------------------------------------------------------------------------
// CONSTANTS DEFINITION

.EQU	OLED_INI_LEN	=	8		// BYTES TO INITIALIZE OLED DISPLAY
.EQU	OLED_INI_DEL	=	50		// INITIALIZTION DELAY
.EQU	OLED_ADDR		=	0x78	// OLED ADDRESS + R/W BIT
.EQU	WCOMM			=	0X00	// CONTROL BYTE -> COMMAND MODE
.EQU	WDATA			=	0x40	// CONTROL BYTE -> DATA MODE
.EQU	CHAR_LIM		=	128		// ID OF LAST CHAR IN THE FONT DATABASE (NOT PRINTABLE)
.EQU	NUM_COL			=	128		// NUMBER OF DISPLAY COLUMNS
.EQU	NUM_PAG			=	8		// NUMBER OF DISPLAY PAGES
.EQU	HLIM6X8			=	122		// HORIZONTAL LIMIT FOR PRITING A 6X8 CHAR
.EQU	VLIM6X8			=	7		// VERTICAL LIMIT FOR PRINTING A 6X8 CHAR

// ---------------------------------------------------------------------------------------------------
// INITIALIZES DISPLAY, NO INPUTS REQUIRED, NO REGISTERS ARE CHANGED

DISP_INI:
	PUSH	TMP					// REGISTER(S) BACKUP
	PUSH	PAYLD
	PUSH	ZL
	PUSH	ZH

	LDI		TMP,OLED_INI_DEL	// DELAY FOR POWER STABILIZATION
	RCALL	DELAY_MS

// CONFIGURES POWER REDUCTION
	LDS		TMP,PRR				
	ANDI	TMP,0B01111111		// CLEARS TWI POWER REDUCTION BIT, I.E. TWI IS ACTIVE
	STS		PRR,TMP
//	BITRATE CONFIG ~X KHz @ X MHz 1:1, 1:1
	LDI		TMP,10				// 1:1 DIVIDER
	STS		TWBR,TMP
	LDI		TMP,0				// 1:1 PRESCALER
	STS		TWSR,TMP

	RCALL	TWISTART			// STARTS TWI
	RCALL	CFGCOMM				// SETS TWI TO COMMAND MODE
	LDI		ZH,HIGH(2*DISP_INI_DATA)	// POINTS Z TO DISPLAY INITIALIZATION DATA
	LDI		ZL,LOW(2*DISP_INI_DATA)		
	LDI		TMP,OLED_INI_LEN	// LOADS THE LENGTH OF DISPLAY INITIALIZATION DATA


INI_SEQ:
	LPM		PAYLD,Z+			// LOADS DATA BYTE INTO PAYLD, INCREMENTS POINTER AFTERWARDS
	RCALL	SEND_BYTE
	DEC		TMP					// CHECKS IF ALL BYTES OF CONFIG DATA HAVE BEEN SENT
	BRNE	INI_SEQ				// IF NOT, SENDS NEXT
	RCALL	TWISTOP				// ALL BYTES HAVE BEEN SENT, STOPS TWI

	POP		ZH					// RESTORES REGISTER(S)
	POP		ZL
	POP		PAYLD
	POP		TMP
	RET


// ---------------------------------------------------------------------------------------------------
// SETS TWI TO COMMAND MODE, NO REGISTERS ARE CHANGED

CFGCOMM:
	PUSH	PAYLD				// REGISTER(S) BACKUP

//	RCALL	TWISTART			// SENDS START CONDITION
	LDI		PAYLD,OLED_ADDR		// SENDS ADDRESS
	RCALL	SEND_BYTE
	LDI		PAYLD,WCOMM			// SETS OLED TO COMMAND MODE
	RCALL	SEND_BYTE

	POP		PAYLD				// RESTORES REGISTER(S)
	RET

// ---------------------------------------------------------------------------------------------------
// SETS TWI TO DATA MODE, NO REGISTERS ARE CHANGED

CFGDATA:
	PUSH	PAYLD				// REGISTER(S) BACKUP

//	RCALL	TWISTART			// SENDS START CONDITION
	LDI		PAYLD,OLED_ADDR		// SENDS ADDRES
	RCALL	SEND_BYTE
	LDI		PAYLD,WDATA			// SETS OLED TO DATA MODE
	RCALL	SEND_BYTE

	POP		PAYLD				// RESTORES REGISTER(S)
	RET	

// ---------------------------------------------------------------------------------------------------
// SENDS START CONDITION, NO REGISTERS ARE CHANGED

TWISTART:
	PUSH	TMP					// REGISTER(S) BACKUP

	LDI		TMP,(1<<TWINT)|(1<<TWSTA)|(1<<TWEN)
	STS		TWCR,TMP			// SETS START CONDITION, CLEARS FLAG, ENABLES TWI

WAITSTA:
	LDS		TMP,TWCR			// WAITS UNTIL FLAG TWINT IS SET, CONFIRMING START CONDITION HAS BEEN SENT
	SBRS	TMP,TWINT
	RJMP	WAITSTA

	POP		TMP					// RESTORES REGISTER(S)
	RET

// ---------------------------------------------------------------------------------------------------
// SENDS STOP CONDITION, NO REGISTERS ARE CHANGED (EXCEPT SREG)

TWISTOP:
	PUSH	TMP					// REGISTER(S) BACKUP

	LDI		TMP,(1<<TWINT)|(1<<TWSTO)|(1<<TWEN)
	STS		TWCR,TMP			// SEND STOP CONDITION, CLEAR FLAG

	POP		TMP					// RESTORES REGISTER(S)
	RET
		
// ---------------------------------------------------------------------------------------------------
// SENDS DATA FROM PAYLD, NO REGISTERS ARE CHANGED (EXCEPT SREG)

SEND_BYTE:		
	PUSH	TMP					// REGISTER(S) BACKUP

	STS		TWDR,PAYLD			// MOVES PAYLD TO TWI DATA REGISTER
	LDI		TMP,(1<<TWINT)|(1<<TWEN)
	STS		TWCR,TMP			// ENABLES DATA TRANSFER
WAITTR:
	LDS		TMP,TWCR			// WAITS UNTIL FLAG TWINT IS SET, CONFIRMING DATA HAS BEEN SENT
	SBRS	TMP,TWINT
	RJMP	WAITTR

	POP		TMP					// RESTORES REGISTER(S)
	RET

// ---------------------------------------------------------------------------------------------------
// SET POS FROM POSH -> COLUMNS (0-127), POSV -> PAGES (0-7)
// WORKS WITH CHARS IN THE RANGE 0-123,0-7; 124-126 WORKS BUT WILL BREAK A CHARACTER, 127+ WILL START FROM 0

SET_POS:
	PUSH	POSH				// REGISTER(S) BACKUP
	PUSH	POSV
	PUSH	PAYLD

	CPI		POSH,128			// CHECKS IF HORIZONTAL POSITION IS IN RANGE
	BRLO	HINRANGE			// YES, CONTINUES TO NEXT STEPS
	CLR		POSH				// NO, LOADS FIRST COLUMN
HINRANGE:
	CPI		POSV,8				// CHECKS IF VERTICAL POSITION IS IN RANGE
	BRLO	VINRANGE			// YES, CONTINUES TO NEXT STEPS
	CLR		POSV				// NO, LOADS FIRST PAGE
VINRANGE:
	RCALL	TWISTART			// STARTS TWI
	RCALL	CFGCOMM				// SETS TWI TO COMMAND MODE

	MOV		PAYLD,POSV
	ORI		PAYLD,0XB0			// SETS PAGE: B0 + POSV (0xB0 = 0; 0xB7 = 7)
	RCALL	SEND_BYTE

	MOV		PAYLD,POSH			// SELECTS (MASK) HIGHER NIBBLE OF COLUMN ADDRESS
	ANDI	PAYLD,0X70
	SWAP	PAYLD				// MOVES DATA TO LOWER NIBBLE
	ORI		PAYLD,0X10
	RCALL	SEND_BYTE			// SETS HIGHER NIBBLE OF COLUMN ADDRESS
	MOV		PAYLD,POSH			// SELECTS (MASK) LOWER NIBBLE OF COLUMN ADDRESS
	ANDI	PAYLD,0X0F
	RCALL	SEND_BYTE			// SETS LOWER NIBBLE OF COLUMN ADDRESS

	RCALL	TWISTOP				// STOPS TWI

	POP		PAYLD				// RESTORES REGISTER(S)
	POP		POSV
	POP		POSH
	RET

// ---------------------------------------------------------------------------------------------------
// SENDS STRING UNTIL ***** EOL / END ***** CHAR IS FOUND
// Z MUST BE POINTING TO STRING DATA
// CURSOR LOCATION MUST BE SET BEFOREHAND, I.E., SET_POS FUNCTION
// VALUE IN TMP WILL BE USED AS DELAY BETWEEN PRINTING CONSECUTIVE CHARS
// DOES NOT CHANGE CONTENT OF REGISTERS

PRINTSTR:
	PUSH	PAYLD				// REGISTER(S) BACKUP
	PUSH	POSV
	PUSH	POSH
	PUSH	TMP
	PUSH	ZL
	PUSH	ZH
PRINT_NEXT:
	CPI		POSH,HLIM6X8+1		// CHECKS IF HOR. POSITION IS WITHIN PRINTABLE RANGE
	BRLO	ST_H_OK				// YES, PROCEEDS W/ PRINTING
	CLR		POSH				// NO, LINE BREAK: POSH SET TO FIRST COLUMN;
	INC		POSV				//     POSV SET TO NEXT PAGE;
	CPI		POSV,VLIM6X8+1		// CHECKS IF VERT. POSITION IS WITHIN PRINTABLE RANGE
	BRNE	ST_V_OK				// YES, PROCEEDS W/ PRINTING
	CLR		POSV				// NO, SCREEN BREAK: POSV SET TO FIRST PAGE
ST_V_OK:
	RCALL	SET_POS				// SETS POSITION
ST_H_OK:
	RCALL	DELAY_DS			// DELAY BEFORE PRINTING EACH CHAR
	LDI		PAYLD,6				// UPDATES POSITION "TRACKER"
	ADD		POSH,PAYLD
	LPM		PAYLD,Z+			// LOADS NEXT CHAR
	CPI		PAYLD,CHAR_LIM		// CHECKS IF CHAR WITHIN RANGE
	BREQ	END_PRINT			// NO, FINISHES ROUTINE
	RCALL	CHAR6X8				// YES, PRINTS IT
	RJMP	PRINT_NEXT
END_PRINT:
	POP		ZH					// RESTORES REGISTER(S)
	POP		ZL
	POP		TMP
	POP		POSH
	POP		POSV
	POP		PAYLD
	RET

// ---------------------------------------------------------------------------------------------------
// ERASES SCREEN COMPLETELY // SHOWS IMAGE ON SCREEN (Z MUST POINT TO IMAGE DATA)

CLEAR_SC:
	PUSH	TMP					// REGISTER(S) BACKUP
	CLR		TMP					// TMP = 0 -> CLEARS SCREEN (TRACKS WHAT ROUTINE WAS CALLED)
	RJMP	DUMP_DATA
SHOW_IMAGE:
	PUSH	TMP					// REGISTER(S) BACKUP
	LDI		TMP,1				// TMP = 1 -> SHOWS IMAGE POINTED BY Z (TRACKS WHAT ROUTINE WAS CALLED)
DUMP_DATA:
	PUSH	POSV				// REGISTER(S) BACKUP
	PUSH	POSH
	PUSH	PAYLD

	LDI		POSV,0				// LOADS VERTICAL COORDINATE TO FIRST PAGE
	LDI		PAYLD,0				// LOADS DATA CORRESPONDING TO "CLEAR SCREEN" (ALL PIXELS OFF)
PAGES:
	LDI		POSH,0				// LOADS HORIZONTAL COORDINATE TO FIRST COLUMN
	RCALL	SET_POS				// SETS POSITION
COLUMNS:
	RCALL	TWISTART			// (RE)STARTS TWI
	RCALL	CFGDATA				// SETS TWI TO DATA MODE
	CPI		TMP,0				// CHECKS IF FUNCTION CALLED IS CLEAR_SC (TMP = 0) OR SHOW_IMAGE (TMP = !0)
	BREQ	EMPTY_SCREEN		// TMP = 0
	LPM		PAYLD,Z+			// TMP != 0
EMPTY_SCREEN:
	RCALL	SEND_BYTE			// SENDS DATA FROM PAYLD
	INC		POSH				// INCREMENTS COUNTER TO NEXT COLUMN
	CPI		POSH,NUM_COL		// CHECKS IF COUNTER REACHED LIMIT (OVER LAST COLUMN)
	BRNE	COLUMNS				// NOT YET, SENDS NEXT BYTE (COLUMN)
	RCALL	TWISTOP				// 128 BYTES ALREADY SENT, STOPS TWI

	INC		POSV				// INCREMENTS COUNTER TO NEXT PAGE
	CPI		POSV,NUM_PAG		// CHECKS IF COUNTER REACHED LIMIT (OVER LAST PAGE)
	BRNE	PAGES				// NOT YET, SENDS NEXT PAGE
								// 8 PAGES ALREADY SENT, FINISHES ROUTINE
	POP		PAYLD				// RESTORES REGISTER(S)
	POP		POSH
	POP		POSV
	POP		TMP
	RET
		
// ---------------------------------------------------------------------------------------------------
// PRINTS CHAR STORED IN PAYLD
// "CURSOR" LOCATION MUST BE DEFINED, I.E., SET_POS MUST BE CALLED BEFORE USING THIS FUNCTION

CHAR6X8:
	PUSH	PAYLD				// REGISTER(S) BACKUP
	PUSH	TMP
	PUSH	ZL
	PUSH	ZH

	CPI		PAYLD,CHAR_LIM		// CHECKS IF CHAR IS PRINTABLE (I.E. WITHIN THE RANGE OF PRE-DEFINED CHARS)
	BRLO	CHAR_IN_RANGE
	RJMP	END_CHAR6X8			// IF NOT, ENDS SUBROUTINE
CHAR_IN_RANGE:
	RCALL	TWISTART			// STARTS TWI
	RCALL	CFGDATA				// SETS TWI TO DATA MODE
	LDI		ZH,HIGH(2*FONT_6X8)	// POINTS Z TO FONT DATA
	LDI		ZL,LOW(2*FONT_6X8)
	LDI		TMP,6				// MULTIPLIES CHAR ID BY 6 (6 BYTES PER CHAR)
	MUL		TMP,PAYLD
	ADD		ZL,R0				// POINTS Z TO DATA FOR CORRESPONDING CHAR
	ADC		ZH,R1

	LDI		TMP,0				// CLEARS COUNTER
NEXT_CHAR_COL:
	LPM		PAYLD,Z+			// READS DATA BYTE (COLUMN)
	RCALL	SEND_BYTE			// SENDS DATA READ
	INC		TMP					// INCREMENTS COUNTER
	CPI		TMP,6				// CHECKS IF COUNTER REACHED LIMIT
	BRNE	NEXT_CHAR_COL		// NOT YET, SENDS NEXT BYTE (COLUMN)
	RCALL	TWISTOP				// 6 BYTES ALREADY SENT, STOPS TWI
END_CHAR6X8:
	POP		ZH					// RESTORES REGISTER(S)
	POP		ZL
	POP		TMP
	POP		PAYLD
	RET

// ---------------------------------------------------------------------------------------------------
// 
OLED_B:
	PUSH	PAYLD				// REGISTER(S) BACKUP
	
	RCALL	TWISTART			// STARTS TWI
	RCALL	CFGCOMM				// SETS TWI TO COMMAND MODE
	LDI		PAYLD,0XA7			// SENDS COMMAND TO BLACK PIXELS IN WHITE BACKGROUND
	RCALL	SEND_BYTE
	RCALL	TWISTOP				// STOPS TWI
	
	POP		PAYLD				// RESTORES REGISTER(S)
	RET

// ---------------------------------------------------------------------------------------------------
// 
OLED_W:
	PUSH	PAYLD				// REGISTER(S) BACKUP

	RCALL	TWISTART			// STARTS TWI
	RCALL	CFGCOMM				// SETS TWI TO COMMAND MODE
	LDI		PAYLD,0XA6			// SENDS COMMAND TO WHITE PIXELS IN BLACK BACKGROUND
	RCALL	SEND_BYTE
	RCALL	TWISTOP				// STOPS TWI
		
	POP		PAYLD				// RESTORES REGISTER(S)
	RET

// ---------------------------------------------------------------------------------------------------
// 

DISP_INI_DATA:		// Initialization Sequence
.DB 0x20, 0x10, 0xC8, 0xA1, 0x8D, 0x14, 0xAF, 0xE3 // SHORT CONFIG

/*	
0xAE,			// Display OFF (sleep mode)
0x20, 0x00,		// Set Memory Addressing Mode: 00=Horizontal Addressing Mode; 01=Vertical Addressing Mode; 10=Page Addressing Mode (RESET); 11=Invalid
0xC8,			// Set COM Output Scan Direction (0xC0 / 0xC8 -> "mirror image")  -> can be ommitted ***
0xA1,			// Set Segment Re-map. A0=column address 0 is mapped to SEG0 (RESET); A1=column address 127 is mapped to SEG0 (upside down)  -> can be ommitted ***
0x8D, 0x14,		// Charge pump setting
0xAF			// Display ON in normal mode

0x21, 0x00, 0x7F,	// SET COLUMN START AND END FOR HORIZONTAL/VERTICAL ADDRESSING MODES
0x22, 0x00, 0x07	// SET PAGE START AND END FOR HORIZONTAL/VERTICAL ADDRESSING MODES
0xB0,			// Set Page Start Address for Page Addressing Mode, 0-7 -> can be ommitted
0x00,			// ---set low column address -> can be ommitted
0x10,			// ---set high column address -> can be ommitted
0x40,			// --set start line address -> can be ommitted
0x81, 0x80,		// Set contrast control -> can be ommitted
0xA6,			// Set Normal/Inverse D. A6=Normal (white in black); A7=Inverse (black in white) -> can be ommitted
0xA8, 0x3F,		// Set multiplex ratio (default=0x3F) -> can be ommitted
0xA4,			// Output RAM to Display; 0xA4=Output follows RAM content; 0xA5,Output ignores RAM content -> can be ommitted
0xD3, 0x00,		// Set display offset (vertical shift from 0x0 to 0x3F; default=0) -> can be ommitted
0xD5, 0xF0,		// Set Display Clock Divide Ratio/Oscillator frequency -> can be ommitted
0xD9, 0x22,		// Set pre-charge period -> can be ommitted
0xDA, 0x12,		// Set COM pins Hardware Configuration -> can be ommitted	
0xDB, 0x20		// --set vcomh 0x20,0.77xVcc (RESET) -> can be ommitted
*/


// BACKUP
//.DB 0xAE, 0x20, 0x00, 0xB0, 0xC8, 0x00, 0x10, 0x40, 0x81, 0x80, 0xA1, 0xA6, 0xA8, 0x3F, 0xA4, 0xD3, 0x00, 0xD5, 0xF0, 0xD9, 0x22, 0xDA, 0x12, 0xDB, 0x20, 0x8D, 0x14, 0xAF
//.DB 0xA8, 0x3F, 0xD3, 0x00, 0x40, 0xA1, 0xC8, 0xDA, 0x12, 0x81, 0x80, 0xA4, 0xA6, 0xD5, 0xF0, 0x8D, 0x14, 0xAF, 0x20, 0x10, 0xB0, 0x00, 0x10, 0xE3  // DATASHEET FLOWCHART + PAGE ADDRESSING CONFIG
//.DB 0xE3, 0xE3, 0xE3, 0xE3, 0xE3, 0xE3, 0xE3, 0xE3, 0xE3, 0xE3, 0xE3, 0xE3, 0xE3, 0xE3, 0xE3, 0xE3, 0xE3, 0xE3, 0xE3, 0xE3, 0xE3, 0xE3, 0xE3, 0xE3, 0xE3, 0xE3, 0xE3, 0xE3


FONT_6X8:		// FONT DATA, 6 COLUMNS X 8 LINES (1 PAGE)
.DB 0xC3, 0x81, 0x18, 0x18, 0x81, 0xC3 //		0
.DB 0x00, 0x00, 0x00, 0x00, 0x81, 0xFF // 1
.DB 0xFF, 0x81, 0x00, 0x00, 0x00, 0x00 // 2
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.DB 0x00, 0x08, 0x2A, 0x1C, 0x08, 0x7F // 128
