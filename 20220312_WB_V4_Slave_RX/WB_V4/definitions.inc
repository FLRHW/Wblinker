
// -----------------------------------------------------------------------------------------------
//		I/O DEFINITIONS

// PORTB DEFINITIONS
.EQU	DDRB_INI_M	=	0B00000111		// MASTER MODE
.EQU	DDRB_INI_S	=	0B00000011		// SLAVE MODE
.EQU	LED3		=	0				// LED3 OUTPUT
//.EQU	BRAKE		=	1				// BREAK PWM OUTPUT ON SLAVE MODE (HW CONFIGURABLE VIA MOUNTING OPTION)
//.EQU	PWM_B		=	1				// HALF BRIDGE PWM_B OUTPUT ON MASTER MODE (HW FIX MUST BE APPLIED TO PCB, V4->V4.1)
//.EQU	TP8			=	2				// FREE ON SLAVE MODE, TP8
//.EQU	PWM_A		=	2				// HALF BRIDGE PWM_A OUTPUT ON MASTER MODE (HW FIX MUST BE APPLIED TO PCB, V4->V4.1)
//.EQU	MOSI		=	3				// ICSP MOSI
//.EQU	MISO		=	4				// ICSP MISO
//.EQU	SCK			=	5				// ICSP	SCK
//.EQU	XTAL1		=	6				// CRYSTAL OSCILATOR
//.EQU	XTAL2		=	7				// CRYSTAL OSCILATOR

// PORTC DEFINITIONS
.EQU	DDRC_INI_M	=	0B00110000		// MASTER MODE
.EQU	DDRC_INI_S	=	0B00110011		// SLAVE MODE
.EQU	RIGHT		=	0				// RIGHT INPUT (MASTER) / OUTPUT (SLAVE)
.EQU	LEFT		=	1				// LEFT INPUT (MASTER) / OUTPUT (SLAVE)
//.EQU	LEVEL_DET	=	2				// ADC INPUT FOR LEVEL DETECTION (MASTER ONLY)
//.EQU	12V_MEAS	=	3				// ADC INPUT FOR 12V MEASUREMENT
//.EQU	SDA			=	4				// SDA, OLED I2C
//.EQU	SCL			=	5				// SCL, OLED I2C
//.EQU	RST			=	6				// ICSP /RST AND MAIN RESET INPUT
//.EQU				=	7				// NA

// PORTD DEFINITIONS
.EQU	DDRD_INI_M	=	0B10011010		// MASTER MODE
.EQU	DDRD_INI_S	=	0B10011010		// SLAVE MODE
//.EQU	RXN			=	0				// UART INPUT
//.EQU	TXN			=	1				// UART OUTPUT
.EQU	HW_ID		=	2				// HW ID INPUT, HIGH = MASTER, LOW = SLAVE
//.EQU	TH_ADJ		=	3				// THRESHOLD ADJUST PWM OUTPUT (MASTER ONLY)
.EQU	LED2		=	4				// LED2 OUTPUT
//.EQU	PWM_A		=	5				// NOT USED IN SLAVE MODE; SHORTED TO PWM A OUTPUT IN MASTER MODE WITH HW FIX (V4->V4.1)
//.EQU	PWM_B		=	6				// NOT USED IN SLAVE MODE; SHORTED TO PWM B OUTPUT IN MASTER MODE WITH HW FIX (V4->V4.1)
.EQU	LED1		=	7				// LED1 OUTPUT


/* NOT IN PORTS
ADC6 -> ADC INPUT FOR PUSH BUTTONS
ADC7 -> ADC INPUT FOR BRAKE SIGNAL (HW CONFIGURABLE VIA MOUNTING OPTION)
*/

// -----------------------------------------------------------------------------------------------
//		REGISTER DEFINITIONS
			
//.DEF				=	R0				// RESERVED FOR MULTIPLICATIONS
//.DEF				=	R1				// RESERVED FOR MULTIPLICATIONS
//.DEF				=	R2				// NOT USED
//.DEF				=	R3				// NOT USED
.DEF	FREQ_L		=	R4				// NOT USED
.DEF	FREQ_M		=	R5				// NOT USED
.DEF	FREQ_H		=	R6				// NOT USED
.DEF	UBAT		=	R7				// BATTERY VOLTAGE X 10, AFTER CONVERSION (I.E.: 12.1 V = 121)

//		REGISTERS FOR 24 BY 16 BIT DIVISION
.DEF    DDRT0		=	R8				// DIVIDER AND RESULT
.DEF    DDRT1		=	R9				// DIVIDER AND RESULT
.DEF    DDRT2		=	R10				// DIVIDER AND RESULT
.DEF	DDRT3		=	R11				// DIVIDER AND RESULT
.DEF    DVRS0		=	R12				// DIVISOR AND REMAINDER
.DEF    DVRS1		=	R13				// DIVISOR AND REMAINDER

.DEF	ADC_C_COUNTER	=	R14			// ADC DUMMY CYCLES COUNTER
//.DEF				=	R15				// NOT USED

//		TEMPORARY REGISTERS
.DEF	TMP			=	R16				// GENERAL USE
.DEF	TMP2		=	R17				// GENERAL USE
.DEF	TMP3		=	R18				// GENERAL USE
.DEF	TMP4		=	R19				// GENERAL USE
.DEF	TMP5		=	R20				// GENERAL USE
.DEF	TMP6		=	R21				// GENERAL USE

//		GENERAL PURPOSE REGISTERS
.DEF	DATA_OUT	=	R22				// STORES DATA TO BE SENT OVER UART
.DEF	DATA_IN		=	R23				// STORES DATA RECEIVE OVER UART
.DEF	ERRCNT		=	R24				// ERROR COUNTER
.DEF	FL			=	R25				// GENERAL PURPOSE FLAGS
	.EQU	MASTER		=	0				// 0 = SLAVE_MODE					1 = MASTER_MODE
	.EQU	RX_WIN		=	1
	.EQU	TX_CP		=	2				// 0 = TX COMPLETE INTERRUPT HAS *** NOT *** BEEN HANDLED SINCE LAST TX START
											// 1 = TX COMPLETE INTERRUPT HAS BEEN HANDLED SINCE LAST TX START
	.EQU	T0_TX		=	3				// T0_TX:T0_RXEN -> TIMER INTERRUPT STATE
	.EQU	T0_RXEN		=	4				// 00 = NEXT INTERRUPT SHALL DISABLE RX WINDOW AND CONFIGURE TIMER FOR TX_HF_DEL
											// 01 = NEXT INTERRUPT SHALL ENABLE RX WINDOW AND CONFIGURE TIMER FOR TX_HF_DEL
											// 10 = NEXT INTERRUP SHALL TRANSMIT DATA AND CONFIGURE TIMER FOR RXEN_DEL
											// 11 = RESERVED
	.EQU	ADC_REF_C	=	5				// 0 = ADC REFERENCE HAS NOT BEEN CHANGED SINCE LAST CONVERSION
											// 1 = ADC REFERENCE HAS BEEN CHANGED SINCE LAST CONVERSION				
//	.EQU	NEW_DATA	=	0				// 0 = NO NEW DATA					1 = NEW DATA HAS EBEN RECEIVED BY UART
//	.EQU	TX_ERR		=	2				// 0 = NO TRANSMISSION ERROR		1 = TRANSMISSION ERROR OCCURED
//	.EQU	RX_ERR		=	3				// 0 = NO RECEPTION ERROR			1 = RECEPTION ERROR OCCURED
//	.EQU	TX_RDY		=	4				// 0 = NOT READY FOR TRANSMISSION	0 = READY FOR TRANSMISSION START
	
	
	
	
	// 0 = TIMER OVERFLOW INTERRUPT ROUTINE HAS NOT YET BEEN SERVICED FOR TRANSMISSION AFTER LAST TX COMPLETE INTERRUPT
												// 1 = TIMER OVERFLOW INTERRUPT HAS ALREADY BEEN SERVICED AFTER LAST TX COMPLETE INTERRUPT 
												// THE PURPOSE OF THE ABOVE FLAG IS TO DIVIDE BY 2 THE FREQUENCY OF PACKETS SENT TO
												// RECEIVER, AS THE PRESCALER ALONE IS NOT ENOUGH TO BRING THIS FREQUENCY DOWN TO 40 Hz 
//	.EQU	DELRESP		=	7				// FLAG, BIT 1, FLAG PARA CONTROLAR O DELAY DE RESPOSTA

//		DISPLAY REGISTERS
.DEF	POSH		=	R26				// HORIZONTAL POSITION (COLUMN) TO START PRINTING DATA, 0 TO 127
.DEF	POSV		=	R27				// VERTICAL POSITION (PAGE) TO START PRINTING DATA, 0 TO 8
.DEF	PAYLD		=	R28				// DATA TO BE PRINTED
.DEF	SW_DATA		=	R29				// SWITCH DATA
//.DEF				=	R30				// RESERVED, Z POINTER
//.DEF				=	R31				// RESERVED, Z POINTER

// -----------------------------------------------------------------------------------------------
//		SRAM STORAGE

.DSEG
AIN_RIGHT:	.BYTE 1						// ADC0
AIN_LEFT:	.BYTE 1						// ADC1
AIN_L_DET:	.BYTE 1						// ADC2
AIN_12V:	.BYTE 1						// ADC3
AIN_SW:		.BYTE 1						// ADC6
AIN_BRAKE:	.BYTE 1						// ADC7
//FREQ_H:		.BYTE 1						// MASTER PWM FREQUENCY (HIGH BYTE)
//FREQ_M:		.BYTE 1						// MASTER PWM FREQUENCY (MID BYTE) 
//FREQ_L:		.BYTE 1						// MASTER PWM FREQUENCY (LOW BYTE)

//.EQU	RAM_SZ	=	9*1				// NUMBER OF SRAM BYTES TAKEN BY DATA STORAGE - MAX SUPPORTED: 256 BYTES

// -----------------------------------------------------------------------------------------------
//		STORAGE FOR MIXED DATA

//:	.BYTE 1						
 
// -----------------------------------------------------------------------------------------------
//		CONSTANT DEFINITIONS

.EQU	FREQ		=	20				// OSCILLATOR FREQUENCY IN MHz
.EQU	FREQHZ		=	FREQ*1000000	// OSCILLATOR FREQUENCY IN Hz
.EQU	FC			=	210000			// CARRIER FREQUENCY (Y)
.EQU	DEF_ICR_H	=	HIGH(FREQHZ/FC-1)	// CONSTANT "TOP" = X FOR PWM @ Y Hz (HIGH BYTE) -> TOP = fclkio/(N*fpwm)-1 = 20 MHz/(1 * Y kHz) - 1 = X
.EQU	DEF_ICR_L	=	LOW(FREQHZ/FC-1)	// CONSTANT "TOP" = X FOR PWM @ Y Hz (LOW BYTE) -> TOP = fclkio/(N*fpwm)-1 = 20 MHz/(1 * Y kHz) - 1 = X

.EQU	BAUD_RATE	=	14400
.EQU	BAUDH		=	HIGH(FREQHZ/(16*BAUD_RATE)-1)
.EQU	BAUDL		=	LOW(FREQHZ/(16*BAUD_RATE)-1)

//.EQU	DUTY_LOW	=	10
//.EQU	DUTY_HIGH	=	254

//.EQU	LIMERR		=	10				// TX ERROR LIMIT
.EQU	DEFAULT		=	248				// DEFAULT DATA_OUT VALUE
//.EQU	FAILURE		=	0

.EQU	ESQ_D		=	2				// BIT CORRESPONDING TO LEFT BLINKER ON DATA PACKET
.EQU	DIR_D		=	1				// BIT CORRESPONDING TO RIGHT BLINKER ON DATA PACKET
.EQU	FREIO_D		=	0				// BIT CORRESPONDING TO BRAKE ON DATA PACKET
.EQU	ZERO		=	48				// ZERO IN ASCII TABLE

.EQU	RXEN_DEL	=	19				// DELAY BETWEEN TX START AND RX ENABLE WINDOW ON MASTER MODE (19 CORRESPONDS TO ~1 ms @ 20 MHz, 1024:1)
.EQU	TX_HF_DEL	=	233				// HALF OF THE DELAY BETWEEN RX ENABLE WINDOW AND TX START ON MASTER MODE (233 CORRESPONDS TO ~12 ms @ 20 MHz, 1024:1)
.EQU	R_T_DEL		=	5				// DELAY BETWEEN RX COMPLETE AND TX START ON SLAVE MODE
//.EQU	ESQ_B		=	2				// BIT CORRESPONDING TO LEFT BLINKER ON DATA PACKET
//.EQU	DIR_B		=	1				// BIT CORRESPONDING TO RIGHT BLINKER ON DATA PACKET
//.EQU	FREIO_B		=	0				// BIT CORRESPONDING TO BRAKE ON DATA PACKET

.EQU	ADC_CFG		=	(1<<REFS0|1<<ADLAR)// 0B11100000 - AVCC AS REFERENCE (CAP IN AREF PIN), LEFT AJUSTED, STARTS AT CH 0
.EQU	ADC_WAIT_CYCLES = 100			// DUMMY CYCLES OF ADC CONVERSION UNTIL VREF IS STABLE AFTER CHANGES

//.EQU	LIM_FREIO	=	0B01000000
//.EQU	ZERA_FREIO	=	0B11111110
//.EQU	SETA_FREIO	=	0B00000001
//.EQU	ZERA_ESQ	=	0B11111011
//.EQU	SETA_ESQ	=	0B00000100
//.EQU	ZERA_DIR	=	0B11111101
//.EQU	SETA_DIR	=	0B00000010


// -----------------------------------------------------------------------------------------------
//		INTERRUPTION VECTORS

.CSEG
.ORG	0X000
	RJMP	CONFIG						// RESET
.ORG	0X00E
	RJMP	TMR0_COMPA					// COMPARE MATCH A IN TMR0
.ORG	0X012
	RJMP	USART_RX					// USART DATA RECEIVED
.ORG	0X014
	RJMP	USART_TX					// USART DATA TRANSMITTED
.ORG	0X015
	RJMP	ADC_COMPLETE				// ADC CONVERSION COMPLETE


// -----------------------------------------------------------------------------------------------
//		'WBLINKER' LOGO, 128 x 64

IMAGE:/*
.DB 0x00, 0x00, 0x00, 0x00, 0x00, 0x00, 0x00, 0x00, 0x00, 0x00, 0x00, 0x00, 0x00, 0x00, 0x00, 0x00, 0x00, 0x00, 0x00, 0x00, 0x00, 0x00, 0x00, 0x00, 0x00, 0x00, 0x00, 0x00, 0x00, 0x00, 0x00, 0x00, 0x00, 0x00, 0x00, 0x00, 0x00, 0x00, 0x80, 0x80, 0xc0, 0xc0, 0xc0, 0xe0, 0xe0, 0xe0, 0xf0, 0xf0, 0xf0, 0xf8, 0xf8, 0xf8, 0xf8, 0xf8, 0xf8, 0xfc, 0xfc, 0xfc, 0xfc, 0xfc, 0xfc, 0xfc, 0xfc, 0xfc, 0xfc, 0xfc, 0xfc, 0xfc, 0xfc, 0xfc, 0xfc, 0xfc, 0xfc, 0xf8, 0xf8, 0xf8, 0xf8, 0xf8, 0xf8, 0xf0, 0xf0, 0xf0, 0xe0, 0xe0, 0xe0, 0xc0, 0xc0, 0xc0, 0x80, 0x80, 0x00, 0x00, 0x00, 0x00, 0x00, 0x00, 0x00, 0x00, 0x00, 0x00, 0x00, 0x00, 0x00, 0x00, 0x00, 0x00, 0x00, 0x00, 0x00, 0x00, 0x00, 0x00, 0x00, 0x00, 0x00, 0x00, 0x00, 0x00, 0x00, 0x00, 0x00, 0x00, 0x00, 0x00, 0x00, 0x00, 0x00, 0x00
.DB 0x00, 0x00, 0x00, 0x00, 0x00, 0x00, 0x00, 0x00, 0x00, 0x00, 0x00, 0x00, 0x00, 0x00, 0x00, 0x00, 0x00, 0x00, 0x00, 0x00, 0x00, 0x00, 0x00, 0x00, 0x00, 0x80, 0x80, 0xc0, 0xe0, 0xf0, 0xf0, 0xf8, 0xfc, 0xfc, 0xfe, 0xfe, 0xff, 0xff, 0xff, 0xff, 0xff, 0x7f, 0x7f, 0x3f, 0x3f, 0x1f, 0x1f, 0x1f, 0x0f, 0x0f, 0x0f, 0x0f, 0x07, 0x07, 0x07, 0x07, 0x03, 0x03, 0x03, 0x03, 0x03, 0x03, 0x03, 0x03, 0x03, 0x03, 0x03, 0x03, 0x03, 0x03, 0x03, 0x03, 0x07, 0x07, 0x07, 0x07, 0x0f, 0x0f, 0x0f, 0x0f, 0x1f, 0x1f, 0x1f, 0x3f, 0x3f, 0x7f, 0x7f, 0xff, 0xff, 0xff, 0xff, 0xff, 0xfe, 0xfe, 0xfc, 0xfc, 0xf8, 0xf0, 0xf0, 0xe0, 0xc0, 0x80, 0x80, 0x00, 0x00, 0x00, 0x00, 0x00, 0x00, 0x00, 0x00, 0x00, 0x00, 0x00, 0x00, 0x00, 0x00, 0x00, 0x00, 0x00, 0x00, 0x00, 0x00, 0x00, 0x00, 0x00, 0x00, 0x00
.DB 0x00, 0x00, 0x00, 0x00, 0x00, 0x00, 0x00, 0x00, 0x00, 0x00, 0x00, 0x00, 0x00, 0x00, 0x00, 0x00, 0x00, 0x00, 0x00, 0x00, 0x00, 0x08, 0x1c, 0x3e, 0x7f, 0xff, 0xff, 0xff, 0xff, 0x7f, 0x3f, 0x1f, 0x0f, 0x0f, 0x07, 0x03, 0x03, 0x01, 0x00, 0x00, 0x00, 0x80, 0x80, 0xc0, 0xc0, 0xe0, 0xe0, 0xf0, 0xf0, 0xf0, 0xf8, 0xf8, 0xf8, 0xf8, 0xfc, 0xfc, 0xfc, 0xfc, 0xfc, 0xfe, 0xfe, 0xfe, 0xfe, 0xfe, 0xfe, 0xfe, 0xfe, 0xfe, 0xfe, 0xfc, 0xfc, 0xfc, 0xfc, 0xfc, 0xf8, 0xf8, 0xf8, 0xf8, 0xf0, 0xf0, 0xf0, 0xe0, 0xe0, 0xc0, 0xc0, 0x80, 0x80, 0x00, 0x00, 0x00, 0x01, 0x03, 0x03, 0x07, 0x0f, 0x0f, 0x1f, 0x3f, 0x7f, 0xff, 0xff, 0xff, 0xff, 0x7f, 0x3e, 0x1c, 0x08, 0x00, 0x00, 0x00, 0x00, 0x00, 0x00, 0x00, 0x00, 0x00, 0x00, 0x00, 0x00, 0x00, 0x00, 0x00, 0x00, 0x00, 0x00, 0x00, 0x00, 0x00
.DB 0x00, 0x00, 0x00, 0x00, 0x00, 0x00, 0x00, 0x00, 0x00, 0x00, 0x00, 0x00, 0x00, 0x00, 0x00, 0x00, 0x00, 0x00, 0x00, 0x00, 0x00, 0x00, 0x00, 0x00, 0x00, 0x00, 0x01, 0x01, 0x00, 0x00, 0x00, 0x00, 0x40, 0xe0, 0xf0, 0xf8, 0xf8, 0xfc, 0xfe, 0xff, 0xff, 0xff, 0xff, 0xff, 0xff, 0x7f, 0x3f, 0x3f, 0x1f, 0x1f, 0x1f, 0x0f, 0x0f, 0x0f, 0x07, 0x07, 0x07, 0x07, 0x03, 0x03, 0x03, 0x03, 0x03, 0x03, 0x03, 0x03, 0x03, 0x03, 0x03, 0x03, 0x07, 0x07, 0x07, 0x07, 0x0f, 0x0f, 0x0f, 0x1f, 0x1f, 0x1f, 0x3f, 0x3f, 0x7f, 0xff, 0xff, 0xff, 0xff, 0xff, 0xff, 0xfe, 0xfc, 0xf8, 0xf8, 0xf0, 0xe0, 0x40, 0x00, 0x00, 0x00, 0x00, 0x01, 0x01, 0x00, 0x00, 0x00, 0x00, 0x00, 0x00, 0x00, 0x00, 0x00, 0x00, 0x00, 0x00, 0x00, 0x00, 0x00, 0x00, 0x00, 0x00, 0x00, 0x00, 0x00, 0x00, 0x00, 0x00, 0x00, 0x00
.DB 0x00, 0x00, 0x00, 0x00, 0x00, 0x00, 0x00, 0x00, 0x00, 0x00, 0x00, 0x80, 0xc0, 0xe0, 0xf0, 0xf0, 0x00, 0x00, 0x00, 0x00, 0x00, 0x00, 0x00, 0x00, 0x00, 0x00, 0x00, 0x00, 0x00, 0x00, 0x00, 0x00, 0x00, 0x00, 0x01, 0x03, 0x07, 0x0f, 0x0f, 0x07, 0x07, 0x03, 0x01, 0x00, 0x00, 0x00, 0x80, 0xc0, 0xc0, 0xe0, 0xe0, 0xf0, 0xf0, 0xf8, 0xf8, 0xf8, 0xfc, 0xfc, 0xfc, 0xfc, 0xfe, 0xfe, 0xfe, 0xfe, 0xfe, 0xfe, 0xfe, 0xfe, 0xfc, 0xfc, 0xfc, 0xfc, 0xf8, 0xf8, 0xf8, 0xf0, 0xf0, 0xe0, 0xe0, 0xc0, 0xc0, 0x80, 0x00, 0x00, 0x00, 0x01, 0x03, 0x07, 0x07, 0x0f, 0x0f, 0x07, 0x03, 0x01, 0x00, 0x00, 0x00, 0x00, 0x00, 0x00, 0x00, 0x00, 0x00, 0x00, 0x00, 0x00, 0x00, 0x00, 0x00, 0x00, 0x00, 0x00, 0xf0, 0xf0, 0xe0, 0xc0, 0x80, 0x00, 0x00, 0x00, 0x00, 0x00, 0x00, 0x00, 0x00, 0x00, 0x00, 0x00
.DB 0x00, 0x00, 0x00, 0x80, 0xc0, 0xe0, 0xf0, 0xf8, 0xfc, 0xfe, 0xff, 0xff, 0xff, 0xff, 0xff, 0xff, 0xfc, 0xfc, 0xfc, 0xfc, 0xfc, 0xfc, 0xfc, 0xfc, 0xfc, 0xfc, 0xfc, 0xfc, 0x00, 0x00, 0x00, 0x00, 0x00, 0x00, 0x00, 0x00, 0x00, 0x00, 0x00, 0x00, 0x00, 0x00, 0x00, 0x00, 0x06, 0x0f, 0x1f, 0x3f, 0x7f, 0x7f, 0x3f, 0x1f, 0x1f, 0x0f, 0x0f, 0x07, 0x07, 0x03, 0x03, 0x03, 0x03, 0x01, 0x01, 0x01, 0x01, 0x01, 0x01, 0x03, 0x03, 0x03, 0x03, 0x07, 0x07, 0x0f, 0x0f, 0x1f, 0x1f, 0x3f, 0x7f, 0x7f, 0x3f, 0x1f, 0x0f, 0x06, 0x00, 0x00, 0x00, 0x00, 0x00, 0x00, 0x00, 0x00, 0x00, 0x00, 0x00, 0x00, 0x00, 0x00, 0x00, 0x00, 0xfc, 0xfc, 0xfc, 0xfc, 0xfc, 0xfc, 0xfc, 0xfc, 0xfc, 0xfc, 0xfc, 0xfc, 0xff, 0xff, 0xff, 0xff, 0xff, 0xff, 0xfe, 0xfc, 0xf8, 0xf0, 0xe0, 0xc0, 0x80, 0x00, 0x00, 0x00
.DB 0x00, 0x00, 0x03, 0x07, 0x0f, 0x1f, 0x3f, 0x7f, 0xff, 0xff, 0xff, 0xff, 0xff, 0xff, 0xff, 0xff, 0xff, 0xff, 0xff, 0xff, 0xff, 0xff, 0xff, 0xff, 0xff, 0xff, 0xff, 0xff, 0x00, 0x00, 0x00, 0x00, 0x00, 0x00, 0x00, 0x00, 0x00, 0x00, 0x00, 0x00, 0x00, 0x00, 0x00, 0x00, 0x00, 0x00, 0x00, 0x00, 0x00, 0x00, 0x00, 0x00, 0x00, 0x00, 0x10, 0x38, 0x78, 0xfc, 0xfc, 0xfe, 0xfe, 0xfe, 0xfe, 0xfe, 0xfe, 0xfe, 0xfe, 0xfe, 0xfe, 0xfc, 0xfc, 0x78, 0x38, 0x10, 0x00, 0x00, 0x00, 0x00, 0x00, 0x00, 0x00, 0x00, 0x00, 0x00, 0x00, 0x00, 0x00, 0x00, 0x00, 0x00, 0x00, 0x00, 0x00, 0x00, 0x00, 0x00, 0x00, 0x00, 0x00, 0x00, 0xff, 0xff, 0xff, 0xff, 0xff, 0xff, 0xff, 0xff, 0xff, 0xff, 0xff, 0xff, 0xff, 0xff, 0xff, 0xff, 0xff, 0xff, 0xff, 0xff, 0x7f, 0x3f, 0x1f, 0x0f, 0x07, 0x03, 0x00, 0x00
.DB 0x00, 0x00, 0x00, 0x00, 0x00, 0x00, 0x00, 0x00, 0x00, 0x01, 0x03, 0x07, 0x0f, 0x1f, 0x3f, 0x3f, 0x00, 0x00, 0x00, 0x00, 0x00, 0x00, 0x00, 0x00, 0x00, 0x00, 0x00, 0x00, 0x00, 0x00, 0x00, 0x00, 0x00, 0x00, 0x00, 0x00, 0x00, 0x00, 0x00, 0x00, 0x00, 0x00, 0x00, 0x00, 0x00, 0x00, 0x00, 0x00, 0x00, 0x00, 0x00, 0x00, 0x00, 0x00, 0x00, 0x00, 0x00, 0x00, 0x01, 0x03, 0x07, 0x0f, 0x1f, 0x3f, 0x3f, 0x1f, 0x0f, 0x07, 0x03, 0x01, 0x00, 0x00, 0x00, 0x00, 0x00, 0x00, 0x00, 0x00, 0x00, 0x00, 0x00, 0x00, 0x00, 0x00, 0x00, 0x00, 0x00, 0x00, 0x00, 0x00, 0x00, 0x00, 0x00, 0x00, 0x00, 0x00, 0x00, 0x00, 0x00, 0x00, 0x00, 0x00, 0x00, 0x00, 0x00, 0x00, 0x00, 0x00, 0x00, 0x00, 0x00, 0x00, 0x3f, 0x3f, 0x1f, 0x0f, 0x07, 0x03, 0x01, 0x00, 0x00, 0x00, 0x00, 0x00, 0x00, 0x00, 0x00, 0x00
*/
// -----------------------------------------------------------------------------------------------
//

W_STR:
.DB "WIRELESS ", CHAR_LIM

BL_STR:
.DB "BLINKER", CHAR_LIM

V4_M_STR:
.DB "V4 MASTER", CHAR_LIM

V4_S_STR:
.DB "V4 SLAVE ", CHAR_LIM

DO_STR:
.DB "Dout:", CHAR_LIM

DI_STR:
.DB "Din: ", CHAR_LIM

MM_STR:
.DB "MASTER ", CHAR_LIM

SM_STR:
.DB "SLAVE", CHAR_LIM

SW_STR:
.DB "Sw: ", CHAR_LIM, CHAR_LIM

// -----------------------------------------------------------------------------------------------
//		MACRO DEFINITION

// PCHAR	@0		->	PRINTS CHAR @0
.MACRO		P_CHAR
	LDI		PAYLD,@0
	RCALL	CHAR6X8
.ENDMACRO

// POS_DEF	@0,@1	->	DEFINES CURSOR VERTICAL POSITION @0 AND HORIZONTAL POSITION @1	
// WORKS IN THE RANGE 0-123,0-7; 124-126 WORKS WILL BREAK A CHARACTER, 127+ WILL START FROM 0
.MACRO		POS_DEF
	LDI		POSV,@0						// LOADS VERTICAL PRINT POSITION
	LDI		POSH,@1						// LOADS HORIZONTAL PRINT POSITION
	RCALL	SET_POS						// SETS DISPLAY PRINT POSITION
.ENDMACRO

// P_STR	@0,@1	-> PRINTS STRING STORED IN @0 WITH @1 DELAY (mS) BETWEEN CHARS
.MACRO		P_STR
	LDI		ZH,HIGH(2*@0)
	LDI		ZL,LOW(2*@0)
	LDI		TMP,@1
	RCALL	PRINTSTR
.ENDMACRO

// BACKUPS CONTEXT FOR INTERRUPTIONS
.MACRO		CONTEXT_BACKUP
	PUSH	TMP							// BACKUPS TMP
	IN		TMP,SREG
	PUSH	TMP							// BACKUPS SREG
	PUSH	TMP2						// BACKUPS TMP2
.ENDMACRO

// RESTORES CONTEXT AFTER INTERRUPTION ROUTINES ARE SERVICED
.MACRO		CONTEXT_RESTORE
	POP		TMP2						// RESTORES TMP2
	POP		TMP							// RESTORES SREG
	OUT		SREG,TMP	
	POP		TMP							// RESTORES TMP
.ENDMACRO

// BACKUPS EXTENDED CONTEXT FOR INTERRUPTIONS
.MACRO		EXT_CONTEXT_BACKUP
	PUSH	DDRT0
	PUSH	DDRT1
	PUSH	DDRT2
	PUSH	DDRT3
	PUSH	DVRS0
	PUSH	DVRS1
	PUSH	R0
	PUSH	R1
	PUSH	TMP3
	PUSH	TMP4
.ENDMACRO

// RESTORES EXTENDED CONTEXT AFTER INTERRUPTION ROUTINES ARE SERVICED
.MACRO		EXT_CONTEXT_RESTORE
	POP		TMP4
	POP		TMP3
	POP		R1
	POP		R0
	POP		DVRS1
	POP		DVRS0
	POP		DDRT3
	POP		DDRT2
	POP		DDRT1
	POP		DDRT0
.ENDMACRO

.MACRO		LED1_ON
	SBI		PORTD,LED1
.ENDMACRO

.MACRO		LED2_ON
	SBI		PORTD,LED2
.ENDMACRO

.MACRO		LED3_ON
	SBI		PORTB,LED3
.ENDMACRO

.MACRO		LED1_OFF
	CBI		PORTD,LED1
.ENDMACRO

.MACRO		LED2_OFF
	CBI		PORTD,LED2
.ENDMACRO

.MACRO		LED3_OFF
	CBI		PORTB,LED3
.ENDMACRO

.MACRO		LEDS_OFF
	LED1_OFF
	LED2_OFF
	LED3_OFF
.ENDMACRO



	
